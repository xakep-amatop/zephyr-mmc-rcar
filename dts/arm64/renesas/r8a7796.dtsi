/*
 * Device Tree Source for the R-Car H3/M3 (R8A7796) SoC
 *
 * Copyright (C) 2023 EPAM Systems.
 *
 * SPDX-License-Identifier: Apache-2.0
 */
#include "gen3_common/r8a7795_r8a7796_common.dtsi"

/ {
	compatible = "renesas,r8a7796";

	cpus {
		#address-cells = <1>;
		#size-cells = <0>;

		a57_0: cpu@0 {
			compatible = "arm,cortex-a57", "arm,armv8";
			reg = <0x0>;
			device_type = "cpu";
			enable-method = "psci";
		};
	};
};

&cpg {
	compatible = "renesas,r8a7795-cpg-mssr";
};
