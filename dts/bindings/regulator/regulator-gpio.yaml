## dts/bindings/regulator/regulator-gpio.yaml
```yaml
# Copyright 2023 EPAM Systems
# SPDX-License-Identifier: Apache-2.0

description: GPIO-controlled voltage of regulators

include:
  - name: base.yaml
  - name: regulator.yaml
    property-allowlist:
      - regulator-name
      - regulator-init-microvolt
      - regulator-min-microvolt
      - regulator-max-microvolt
      - regulator-always-on
      - regulator-boot-on

compatible: "regulator-gpio"

properties:
  regulator-name:
    required: true

  gpios:
    type: phandle-array
    required: true
    description: |
      GPIO to use to switch voltage.

  gpios-states:
    type: int
    description: |
      On operating systems, that don't support reading back gpio values
      in output mode (most notably linux), this array provides the
      state of GPIO pins set when requesting them from the gpio
      controller. Systems, that are capable of preserving state when
      requesting the lines, are free to ignore this property.
      0: LOW, 1: HIGH. Default is LOW if nothing else is specified.

  states:
    type: array
    description: Selection of available voltages provided by this regulator and
      matching GPIO configurations to achieve them. If there are no states in
      the "states" array, use a fixed regulator instead. First value in an array
      item is voltage in microvolts and the second is GPIO group state value.

  enable-gpios:
    type: phandle-array
    description: GPIO to use to enable/disable the regulator.

  startup-delay-us:
    type: int
    description: startup time in microseconds
```

## dts/bindings/timer/renesas,ostm.yaml
```yaml
description: Renesas OS timer

compatible: "renesas,ostm"

include: base.yaml

properties:
  reg:
    required: true

  clocks:
    required: true

  interrupts:
    required: true
```

## dts/bindings/watchdog/renesas,r8a779f0-wdt.yaml
```yaml
# Copyright (c) 2019 Interay Solutions B.V.
# Copyright (c) Oane Kingma
# SPDX-License-Identifier: Apache-2.0

description: Renesas RCar watchdog driver

compatible: "renesas,r8a779f0-wdt"

include: base.yaml

properties:
  reg:
    required: true

  interrupts:
    required: true

  clocks:
    required: true
```

## dts/bindings/xen/xen,xen-4.15.yaml
```yaml
description: Xen Platform Control Registers v4.15

compatible: "xen,xen-4.15"

include: xen,xen.yaml
```

## samples/subsys/fs/littlefs/boards/rcar_salvator_xs_m3_2x4g.conf
```kconfig
#
# Copyright (c) 2023 EPAM Systems
#
# SPDX-License-Identifier: Apache-2.0
#
CONFIG_MAIN_STACK_SIZE=4096
CONFIG_MINIMAL_LIBC_MALLOC_ARENA_SIZE=8192
CONFIG_FS_LITTLEFS_FC_HEAP_SIZE=8192

CONFIG_DISK_ACCESS=y
CONFIG_DISK_DRIVERS=y
CONFIG_DISK_DRIVER_SDMMC=y

CONFIG_MMC_RCAR=y
CONFIG_MMC_RCA=1

CONFIG_FS_LITTLEFS_BLK_DEV=y
CONFIG_APP_LITTLEFS_STORAGE_BLK_SDMMC=y

CONFIG_FLASH=n
CONFIG_FLASH_MAP=n
CONFIG_FLASH_PAGE_LAYOUT=n
```

## soc/arm/renesas_rz/a2m/Kconfig.defconfig.series
```kconfig
# Renesas RZ A2M SoC line

# Copyright (c) 2023 EPAM Systems
# SPDX-License-Identifier: Apache-2.0

if SOC_SERIES_RZ_A

config SOC_SERIES
	default "a2m"

config NUM_IRQS
	default 512

config PINCTRL
	# default y

endif # SOC_SERIES_RZ_A
```

## soc/arm/renesas_rz/a2m/Kconfig.series
```kconfig
# Copyright (c) 2023 EPAM Systems
# SPDX-License-Identifier: Apache-2.0

config SOC_SERIES_RZ_A
	bool "Renesas RZ A2M Cortex A9"
	select ARM
	select CPU_CORTEX_A9
	select PLATFORM_SPECIFIC_INIT
	select SOC_FAMILY_RZ
	select CLOCK_CONTROL_RENESAS_CPG_MSSR if CLOCK_CONTROL
	help
	  Enable support for Renesas RZ A2M SoC series
```

## soc/arm/renesas_rz/a2m/Kconfig.soc
```kconfig
# Copyright (c) 2023 EPAM Systems
# SPDX-License-Identifier: Apache-2.0

choice
	prompt "Renesas RZ A2M SoC Selection"
	depends on SOC_SERIES_RZ_A

config SOC_R7S9210
	bool "R7S9210"

endchoice
```

## soc/arm/renesas_rz/rz_a/Kconfig.defconfig.series
```kconfig
# Renesas RZ A2M SoC line

# Copyright (c) 2023 EPAM Systems
# SPDX-License-Identifier: Apache-2.0

if SOC_SERIES_RZ_A

config SOC_SERIES
	default "rz_a"

if MULTI_LEVEL_INTERRUPTS

config MAX_IRQ_PER_AGGREGATOR
	default 8

config 2ND_LEVEL_INTERRUPTS
	default y

config 2ND_LVL_ISR_TBL_OFFSET
	default 512

config 2ND_LVL_INTR_00_OFFSET
	default 4

config NUM_2ND_LEVEL_AGGREGATORS
	default 1

endif # MULTI_LEVEL_INTERRUPTS

endif # SOC_SERIES_RZ_A

config NUM_IRQS
	default 520 if 2ND_LEVEL_INTERRUPTS
	default 512 if !2ND_LEVEL_INTERRUPTS
```

## soc/arm64/renesas_rcar/gen3/Kconfig.defconfig.r8a7795
```kconfig
# Copyright (c) 2023 EPAM Systems
# SPDX-License-Identifier: Apache-2.0

if SOC_R8A7795

config SOC
	default "r8a7795"

endif # SOC_R8A7795
```

## soc/arm64/renesas_rcar/gen3/Kconfig.defconfig.r8a7796
```kconfig
# Copyright (c) 2023 EPAM Systems
# SPDX-License-Identifier: Apache-2.0

if SOC_R8A7796

config SOC
	default "r8a7796"

endif # SOC_R8A7796
```

## soc/arm64/renesas_rcar/gen3/Kconfig.defconfig.series
```kconfig
# Renesas R-Car Gen3 SoC line

# Copyright (c) 2023 EPAM Systems
# SPDX-License-Identifier: Apache-2.0

if SOC_SERIES_RCAR_GEN3

config SOC_SERIES
	default "gen3"

config NUM_IRQS
	int
	default 240

config PINCTRL
	default y

config SYS_CLOCK_HW_CYCLES_PER_SEC
	int
	default 8320000

endif # SOC_SERIES_RCAR_GEN3
```

## soc/arm64/renesas_rcar/gen3/Kconfig.series
```kconfig
# Copyright (c) 2023 EPAM Systems
# SPDX-License-Identifier: Apache-2.0

config SOC_SERIES_RCAR_GEN3
	bool "Renesas RCAR Gen3 Cortex A"
	select ARM64
	select CPU_CORTEX_A
	select CPU_CORTEX_A72
	select ARMV8_A
	select GIC_V3 if XENVM_USE_GIC_V3
	select GIC_V2 if !XENVM_USE_GIC_V3
	select SOC_FAMILY_RCAR
	select ARM_ARCH_TIMER
	select CLOCK_CONTROL_RCAR_CPG_MSSR if CLOCK_CONTROL
	help
	  Enable support for Renesas RCar Gen3 SoC series
```

## soc/arm64/renesas_rcar/gen4/Kconfig.series
```kconfig
# Copyright (c) 2023 EPAM Systems
# SPDX-License-Identifier: Apache-2.0

config SOC_SERIES_RCAR_GEN4
	bool "Renesas RCAR Gen4 Cortex A"
	select ARM64
	select CPU_CORTEX_A
	select ARMV8_A
	select GIC_V3
	select SOC_FAMILY_RCAR
	select ARM_ARCH_TIMER
	select CLOCK_CONTROL_RCAR_CPG_MSSR if CLOCK_CONTROL
	help
	  Enable support for Renesas RCar Gen4 SoC series
```

## tests/drivers/disk/disk_performance/boards/rcar_salvator_xs_m3.conf
```kconfig
#
# Copyright (c) 2023 EPAM Systems
#
# SPDX-License-Identifier: Apache-2.0
#

CONFIG_MMC_RCA=1
```

## tests/drivers/disk/disk_performance/testcase.yaml
```yaml
tests:
  drivers.disk.disk_performance:
    depends_on: sdhc
    harness: ztest
    harness_config:
      fixture: fixture_sdhc
    tags: disk sdhc
    integration_platforms:
      - mimxrt1064_evk
      - mimxrt595_evk_cm33
      - rcar_h3ulcb_ca57
      - rcar_salvator_xs_m3
      - rcar_spider
```

## tests/subsys/sd/mmc/boards/rcar_h3ulcb_ca57.conf
```kconfig
# Copyright (c) 2023 EPAM Systems
# SPDX-License-Identifier: Apache-2.0

CONFIG_DISK_ACCESS=y
CONFIG_MMC_RCAR=y
CONFIG_SDHC=y
CONFIG_MMC_RCA=1
```
