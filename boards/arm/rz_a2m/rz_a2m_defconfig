## boards/arm/rz_a2m/rz_a2m_defconfig
```kconfig
CONFIG_SOC_R7S9210=y
CONFIG_SOC_SERIES_RZ_A=y
CONFIG_BOARD_RZ_A2M=y

# dummy value, runtime value will be used from 'renesas,ostm' timer driver
CONFIG_SYS_CLOCK_HW_CYCLES_PER_SEC=33000000

CONFIG_MULTI_LEVEL_INTERRUPTS=y

CONFIG_FLASH_SIZE=0
CONFIG_FLASH_BASE_ADDRESS=0

CONFIG_XIP=n

# Enable clock control
CONFIG_CLOCK_CONTROL=y

# Enable UART driver
CONFIG_SERIAL=y

# Enable console
CONFIG_CONSOLE=y
CONFIG_UART_CONSOLE=y
```

## boards/arm64/rcar_h3ulcb_ca57/Kconfig.board
```kconfig
# Copyright (c) 2023 Volodymyr Babchuk <volodymyr.babchuk@epam.com>
# SPDX-License-Identifier: Apache-2.0

config BOARD_RCAR_H3ULCB_CA57
	bool "Renesas H3ULCB"
	depends on SOC_R8A7795
```

## boards/arm64/rcar_h3ulcb_ca57/Kconfig.defconfig
```kconfig
# Copyright (c) 2023 Volodymyr Babchuk <volodymyr.babchuk@epam.com>
# SPDX-License-Identifier: Apache-2.0

if BOARD_RCAR_H3ULCB_CA57

config BUILD_OUTPUT_BIN
	default y

config BOARD
	default "rcar_h3ulcb_ca57"

endif # BOARD_RCAR_H3ULCB_CA57
```

## boards/arm64/rcar_h3ulcb_ca57/rcar_h3ulcb_ca57_defconfig
```kconfig
CONFIG_SOC_R8A7795=y
CONFIG_SOC_SERIES_RCAR_GEN3=y
CONFIG_BOARD_RCAR_H3ULCB_CA57=y
CONFIG_ARM_ARCH_TIMER=y

# Enable UART driver
CONFIG_SERIAL=y
CONFIG_SRAM_BASE_ADDRESS=0x48000000
CONFIG_KERNEL_VM_BASE=0x48000000
CONFIG_SRAM_SIZE=16384
CONFIG_AARCH64_IMAGE_HEADER=y
CONFIG_SYS_CLOCK_HW_CYCLES_PER_SEC=8300000
CONFIG_XIP=n
CONFIG_FLASH_BASE_ADDRESS=0x0
CONFIG_FLASH_SIZE=0

CONFIG_MAX_XLAT_TABLES=20

# Enable console
CONFIG_CONSOLE=y
CONFIG_UART_RCAR=y
CONFIG_UART_CONSOLE=y
CONFIG_UART_INTERRUPT_DRIVEN=y

# Enable clock control
CONFIG_CLOCK_CONTROL=y
CONFIG_CLOCK_CONTROL_RCAR_CPG_MSSR=y
```

## boards/arm64/rcar_spider_ca55/rcar_spider_ca55_defconfig
```kconfig
CONFIG_SOC_R8A779F0=y
CONFIG_SOC_SERIES_RCAR_GEN4=y
CONFIG_BOARD_RCAR_SPIDER_CA55=y

# Cache management
CONFIG_CACHE_MANAGEMENT=y

# Enable UART driver
CONFIG_SERIAL=y

CONFIG_AARCH64_IMAGE_HEADER=y

CONFIG_SYS_CLOCK_HW_CYCLES_PER_SEC=16666666
CONFIG_TIMER_READS_ITS_FREQUENCY_AT_RUNTIME=y

CONFIG_UART_INTERRUPT_DRIVEN=n
CONFIG_UART_USE_RUNTIME_CONFIGURE=n
CONFIG_XIP=n

CONFIG_MAX_XLAT_TABLES=24

# Enable console
CONFIG_CONSOLE=y
CONFIG_UART_CONSOLE=y

# Enable clock control
CONFIG_CLOCK_CONTROL=y
```

## boards/arm64/renesas_rcar/Kconfig.board
```kconfig
# Copyright (c) 2023 EPAM Systems
# SPDX-License-Identifier: Apache-2.0

source "boards/arm64/renesas_rcar/gen3/*/Kconfig.board"
```

## boards/arm64/renesas_rcar/Kconfig.defconfig
```kconfig
# Copyright (c) 2023 EPAM Systems
# SPDX-License-Identifier: Apache-2.0

source "boards/arm64/renesas_rcar/gen3/*/Kconfig.defconfig"
source "boards/arm64/renesas_rcar/gen4/*/Kconfig.defconfig"

config BUILD_OUTPUT_BIN
	default y
```

## boards/arm64/renesas_rcar/gen3/rcar_h3ulcb_ca57/Kconfig.defconfig
```kconfig
# Copyright (c) 2023 EPAM Systems
# SPDX-License-Identifier: Apache-2.0

if BOARD_RCAR_H3ULCB_CA57

config BOARD
	default "rcar_h3ulcb_ca57"

endif # BOARD_RCAR_H3ULCB_CA57
```

## boards/arm64/renesas_rcar/gen3/rcar_salvator_xs_m3_2x4g/Kconfig.board
```kconfig
# Copyright (c) 2023 EPAM Systems
# SPDX-License-Identifier: Apache-2.0

config BOARD_RCAR_SALVATOR_XS_M3_2X4G
	bool "Renesas Salvator XS M3 2x4g"
	depends on SOC_R8A7796
```

## boards/arm64/renesas_rcar/gen3/rcar_salvator_xs_m3_2x4g/Kconfig.defconfig
```kconfig
# Copyright (c) 2023 EPAM Systems
# SPDX-License-Identifier: Apache-2.0

if BOARD_RCAR_SALVATOR_XS_M3_2X4G

config BOARD
	default "rcar_salvator_xs_m3_2x4g"

endif # BOARD_RCAR_SALVATOR_XS_M3_2X4G
```

## boards/arm64/renesas_rcar/gen4/spider/Kconfig.defconfig
```kconfig
# Copyright (c) 2023 EPAM Systems
# SPDX-License-Identifier: Apache-2.0

if BOARD_RCAR_SPIDER

config BOARD
	default "rcar_spider"

endif # BOARD_RCAR_SPIDER
```

## boards/shields/rcar_mmc/Kconfig.defconfig
```kconfig
# Copyright (c) 2023 EPAM Systems
# SPDX-License-Identifier: Apache-2.0

if SHIELD_RCAR_MMC_H3ULCB_XENVM

# Enable MMC driver
config DISK_ACCESS
	default y

config DISK_DRIVERS
	default y

config MMC_RCAR
	default y

config SDHC
	default y

config MMC_RCA
	default 1

# Enable clock control
config CLOCK_CONTROL
	default y

config CLOCK_CONTROL_RCAR_CPG_MSSR
	default y

config PINCTRL
	default y

endif # SHIELD_RCAR_MMC_H3ULCB_XENVM
```

## boards/shields/rcar_mmc/Kconfig.shield
```kconfig
# Copyright (c) 2023 EPAM Systems
# SPDX-License-Identifier: Apache-2.0

config SHIELD_RCAR_MMC_H3ULCB_XENVM
	def_bool $(shields_list_contains,rcar_mmc_h3ulcb_xenvm)

config SHIELD_RCAR_MMC_H3ULCB
	def_bool $(shields_list_contains,rcar_mmc_h3ulcb)
```

## boards/shields/rcar_mmc/boards/xenvm.defconfig
```kconfig
# Enable MMC driver
CONFIG_DISK_ACCESS=y
CONFIG_DISK_DRIVERS=y
CONFIG_MMC_RCAR=y
CONFIG_SDHC=y
CONFIG_MMC_RCA=1

# Enable clock control
CONFIG_CLOCK_CONTROL=y
CONFIG_CLOCK_CONTROL_RCAR_CPG_MSSR=y

CONFIG_PINCTRL=y
```

## boards/shields/xenvm_dom0/Kconfig.defconfig
```kconfig
# Copyright (c) 2023 EPAm Systems
# SPDX-License-Identifier: Apache-2.0

if SHIELD_XENVM_DOM0

config HEAP_MEM_POOL_SIZE
	default 2097152

# We need at least 16M of virtual address space to map memory of Xen node
# 32M should be enough for basic use-cases
config KERNEL_VM_SIZE
	default 0x2000000

endif # SHIELD_XENVM_DOM0
```

## boards/shields/xenvm_dom0/Kconfig.shield
```kconfig
# Copyright (c) 2023 EPAM Systems, Inc
# SPDX-License-Identifier: Apache-2.0

config SHIELD_XENVM_DOM0
	def_bool $(shields_list_contains,xenvm_dom0)
	depends on ARMV8_A
	select XEN_INITIAL_DOMAIN
```

## drivers/clock_control/Kconfig.renesas
```kconfig
# Copyright (c) 2021-2022 IoT.bzh
# SPDX-License-Identifier: Apache-2.0

config CLOCK_CONTROL_RENESAS_CPG_MSSR
	bool "RCar CPG MSSR driver"
	depends on DT_HAS_RENESAS_R8A7795_CPG_MSSR_ENABLED || DT_HAS_RENESAS_R7S9210_CPG_MSSR_ENABLED
	help
	  Enable support for Renesas RCar CPG MSSR driver.

if SOC_SERIES_RZ_A
if DT_HAS_RENESAS_R7S9210_CPG_MSSR_ENABLED

config RZ_A_CLOCK_CONTROL_SELECT_CKIO
	int
	default 1
	range 0 1
	help
	  CKIO Output Clock Select
		0: B Clock output
		1: P1 Clock output

config RZ_A_CLOCK_CONTROL_SELECT_OCTA_MEMORY
	int
	default 0
	range 0 3
	help
	  Octa memory controller Clock Select
		0: P0 Clock output
		1: P1 Clock output
		2: B Clock output
		3: G Clock output

config RZ_A_CLOCK_CONTROL_SELECT_HYPER_BUS
	int
	default 0
	range 0 3
	help
	  HyperBus controller Clock Select
		0: P0 Clock output
		1: P1 Clock output
		2: B Clock output
		3: G Clock output

config RZ_A_CLOCK_CONTROL_SELECT_SPI_MULTI_IO_BUS
	int
	default 0
	range 0 3
	help
	  SPI multi I/O bus controller Clock Select
		0: P0 Clock output
		1: P1 Clock output
		2: B Clock output
		3: G Clock output

endif # DT_HAS_RENESAS_R7S9210_CPG_MSSR_ENABLED
endif # SOC_SERIES_RZ_A
```

## drivers/interrupt_controller/Kconfig.r7s9210
```kconfig
# Copyright (c) 2023 EPAM Systems
# SPDX-License-Identifier: Apache-2.0

config INTC_R7S9210
	bool "Renesas r7s9210 interrupt controller support"
	default y
	depends on DT_HAS_RENESAS_R7S9210_INTC_ENABLED
	depends on MULTI_LEVEL_INTERRUPTS
	select ARM_CUSTOM_INTERRUPT_CONTROLLER
	help
	  Select this option to enable support for the Renesas r7s9210 interrupt
	  controller driver. This provides a level 2 interrupt controller for
	  the SoC. The INTMUX peripheral combines level 2 interrupts into eight
	  channels; each channel has its own level 1 interrupt to the core.

if INTC_R7S9210

config INTC_R7S9210_INIT_PRIORITY
	int "r7s9210 intc driver initialization priority"
	default 40
	help
	  Boot time initialization priority for r7s9210 intc driver.

endif # INTC_R7S9210
```

## drivers/sdhc/Kconfig.rcar
```kconfig
# Copyright (c) 2023 EPAM Systems
# SPDX-License-Identifier: Apache-2.0

config MMC_RCAR
	bool "Renesas Rcar MMC driver"
	select SDHC_SUPPORTS_NATIVE_MODE
	select REGULATOR
	select GPIO
	default n
	help
	  Renesas Rcar MMC driver.

if MMC_RCAR

config RCAR_MMC_DMA_SUPPORT
	bool "Internal DMA support for Renesas Rcar MMC driver"
	select CACHE_MANAGEMENT
	select DCACHE
	default y
	help
	  Internal DMA support for Renesas Rcar MMC driver.

config RCAR_MMC_SCC_SUPPORT
	bool "Support of SCC"
	default y
	help
	  Enable support of Sampling Clock Controller for Renesas Rcar MMC driver.

if RCAR_MMC_DMA_SUPPORT

config SDHC_BUFFER_ALIGNMENT
	default 128

config RCAR_MMC_DMA_IRQ_DRIVEN_SUPPORT
	bool "Internal DMA IRQ driven support for Renesas Rcar MMC driver"
	default y

endif # RCAR_MMC_DMA_SUPPORT

endif # MMC_RCAR
```

## drivers/timer/Kconfig.rz
```kconfig
# Copyright (c) 2023 EPAM Systems
# SPDX-License-Identifier: Apache-2.0

config RZ_OS_TIMER
	bool "Renesas RZ OS timer"
	default y
	depends on DT_HAS_RENESAS_OSTM_ENABLED
	select TIMER_READS_ITS_FREQUENCY_AT_RUNTIME
	select SYSTEM_TIMER_HAS_DISABLE_SUPPORT
	select TICKLESS_CAPABLE
	help
	  This module implements a kernel device driver for the Renesas RZ
	  platform provides the standard "system clock driver" interfaces.
```

## drivers/watchdog/Kconfig.r8a779f0
```kconfig
# Watchdog configuration options
#
# Copyright (c) 2019 Interay Solutions B.V.
# Copyright (c) 2019 Oane Kingma
#
# SPDX-License-Identifier: Apache-2.0

config WDT_R8A779F0
	bool "Renesas R8A779F0 Watchdog (WDOG) Driver"
	default y
	depends on DT_HAS_RENESAS_R8A779F0_WDT_ENABLED
	help
	  Enable WDOG driver for Renesas R8A779F0 SoCs
```

## drivers/xen/Kconfig
```kconfig
# SPDX-License-Identifier: Apache-2.0
# Copyright (c) 2022 EPAM Systems

if SOC_XENVM || SHIELD_XENVM_DOM0

menu "Xen drivers"

config XEN_INITIAL_DOMAIN
	bool "Zephyr as Xen Domain 0"
	default n
	help
	  Built binary will be used as Xen privileged domain.

config XEN_GRANT_TABLE
	bool "Xen grant table driver"
	depends on HEAP_MEM_POOL_SIZE > 0
	default y
	help
	  Xen grant table driver. Please note that driver uses dynamic memory
	  allocation with k_malloc(), so CONFIG_HEAP_MEM_POOL_SIZE should be
	  >= number of pages, that you want to alloc and grant or foreign frames
	  that you want to map.

config XEN_GRANT_TABLE_INIT_PRIORITY
	int "Grant table driver init priority"
	depends on XEN_GRANT_TABLE
	default 50

endmenu

endif # SOC_XENVM
```

## dts/bindings/clock/renesas,r7s9210-cpg-mssr.yaml
```yaml
# Copyright (c) 2023 EPAM Systems
# SPDX-License-Identifier: Apache-2.0

description: Renesas R7S9210 SoC Clock Pulse Generator/Module Standby and Software Reset

compatible: "renesas,r7s9210-cpg-mssr"

include: renesas,rcar-cpg-mssr.yaml

properties:
  clocks:
    required: true
```

## dts/bindings/interrupt-controller/renesas,r7s9210-intc.yaml
```yaml
# Copyright (c) 2023 EPAM Systems
# SPDX-License-Identifier: Apache-2.0

description: Renesas r7s9210 interrupt controller

compatible: "renesas,r7s9210-intc"

include: [interrupt-controller.yaml, base.yaml]

properties:
  reg:
    required: true

  map:
    type: array
    required: true

  "#address-cells":
    const: 0

  "#interrupt-cells":
    const: 2

interrupt-cells:
  - irq
  - flags
```

## dts/bindings/mmc/renesas,rcar-emmc.yaml
```yaml
description: Renesas R-Car eMMC

compatible: "renesas,rcar-mmc"

include: [sdhc.yaml, mmc.yaml, pinctrl-device.yaml, reset-device.yaml]

properties:
  clocks:
    required: true

  reg:
    required: true

  pinctrl-0:
    required: true

  pinctrl-names:
    required: true

  max-frequency:
    type: int
    default: 200000000
    required: true

  mmc-hs200-1_8v:
    type: boolean

  mmc-hs400-1_8v:
    type: boolean

  non-removable:
    type: boolean

  mmc-sdr104-support:
    type: boolean

  cd-gpios:
    type: phandle-array
    description: Card Detect pin

  pwr-gpios:
    type: phandle-array
    description: Power pin

  vmmc-supply:
    type: phandle
    description:
      Supply for the card power

  vqmmc-supply:
    type: phandle
    description:
      Supply for the bus IO line power, such as a level shifter.
      If the level shifter is controlled by a GPIO line, this shall
      be modeled as a "regulator-fixed" with a GPIO line for
      switching the level shifter on/off.

  bus-width:
    type: int
    default: 1
    description: |
        bus width for SDMMC access, defaults to the minimum necessary
        number of bus lines
    enum:
      - 1
      - 4
      - 8
```
