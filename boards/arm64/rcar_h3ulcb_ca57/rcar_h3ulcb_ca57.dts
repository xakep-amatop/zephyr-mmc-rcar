/*
 * Copyright (c) 2019 Carlo Caione <ccaione@baylibre.com>
 *
 * SPDX-License-Identifier: Apache-2.0
 *
 */

/dts-v1/;
#include <arm64/renesas/r8a7795.dtsi>
#include "rcar_h3ulcb_ca57-pinctrl.dtsi"

/ {
	model = "H3ULCB CA57";

	chosen {
		zephyr,console = &scif2;
		zephyr,shell-uart = &scif2;
	};
};

&scif2 {
	pinctrl-0 = <&scif2_data_a_tx_default &scif2_data_a_rx_default>;
	pinctrl-names = "default";
	status = "okay";
};
